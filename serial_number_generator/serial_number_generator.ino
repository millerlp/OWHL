/* serial_number_generator.ino
	Luke Miller 2015-05-28
	
	This sketch is used to burn a (hopefully) unique serial 
	number to the EEPROM of an AVR ATmega328P.
	
	The serial number is generated by storing the 
	date and time when the sketch is compiled and uploaded
	to the AVR. It consists of a 17-character array
	that starts with "SN" and is made up of the
	date and time. For example:
		SN20150528122030
		
	After writing the serial number to the start of
	the eeprom (starting at address 0), it reads the
	value back and prints it out to the serial monitor.

*/
#include <EEPROM.h>
#include <Wire.h>
#include <SPI.h>
#include "RTClib.h"

// Placeholder serialnumber
char serialnumber[]="SNxxxxxxxxxxxxxx";

void setup(){
	Serial.begin(57600);
	
	DateTime mytime = DateTime(__DATE__, __TIME__);
	printTime(mytime);
	// Use initSN function to generate a serial number
	// based on the current date and time.
	initSN(mytime);
	Serial.print("Generated serial number: ");
	Serial.println(serialnumber);
	
	// Put the contents of serialnumber in EEPROM starting at
	// address 0
	EEPROM.put(0, serialnumber);
	
	char output[sizeof(serialnumber)];
	EEPROM.get(0, output);
	Serial.print("Read serial number: ");
	Serial.println(output);
			
}

void loop() {
	// Do nothing in main loop.
	while(1);
}

//------------------------------------------------------------------------------
// initSN - a function to create a serialnumber for the OWHL based
// on the 4-digit year, month, day, hour, minutes, and seconds. 
// The character array 'serialnumber' was defined as a global array 
// at the top of the sketch.
void initSN(DateTime time1) {
	// Positions 0 and 1 will hold "SN"
	serialnumber[0] = 'S';
	serialnumber[1] = 'N';
	
	char buf[5];
	// integer to ascii function itoa(), supplied with numeric year value,
	// a buffer to hold output, and the base for the conversion (base 10 here)
	itoa(time1.year(), buf, 10);
	// copy the ascii year into the serialnumber array
	// in positions 2,3,4,5
	for (byte i = 0; i <= 4; i++){
		serialnumber[i+2] = buf[i];
	}
	// Insert the month value
	if (time1.month() < 10) {
		serialnumber[6] = '0';
		serialnumber[7] = time1.month() + '0';
	} else if (time1.month() >= 10) {
		serialnumber[6] = (time1.month() / 10) + '0';
		serialnumber[7] = (time1.month() % 10) + '0';
	}
	// Insert the day value
	if (time1.day() < 10) {
		serialnumber[8] = '0';
		serialnumber[9] = time1.day() + '0';
	} else if (time1.day() >= 10) {
		serialnumber[8] = (time1.day() / 10) + '0';
		serialnumber[9] = (time1.day() % 10) + '0';
	}
	// Insert the hour
	if (time1.hour() < 10) {
		serialnumber[10] = '0';
		serialnumber[11] = time1.hour() + '0';
	} else if (time1.hour() >= 10) {
		serialnumber[10] = (time1.hour() / 10) + '0';
		serialnumber[11] = (time1.hour() % 10) + '0';
	}
	// Insert minutes
		if (time1.minute() < 10) {
		serialnumber[12] = '0';
		serialnumber[13] = time1.minute() + '0';
	} else if (time1.minute() >= 10) {
		serialnumber[12] = (time1.minute() / 10) + '0';
		serialnumber[13] = (time1.minute() % 10) + '0';
	}
	// Insert minutes
		if (time1.second() < 10) {
		serialnumber[14] = '0';
		serialnumber[15] = time1.second() + '0';
	} else if (time1.second() >= 10) {
		serialnumber[14] = (time1.second() / 10) + '0';
		serialnumber[15] = (time1.second() % 10) + '0';
	}

} // end of initSN function

//------------------------------------------------
// printTime function takes a DateTime object from
// the real time clock and prints the date and time 
// to the serial monitor. 
void printTime(DateTime now){
	Serial.print(now.year(), DEC);
    Serial.print('-');
    Serial.print(now.month(), DEC);
    Serial.print('-');
    Serial.print(now.day(), DEC);
    Serial.print(' ');
    Serial.print(now.hour(), DEC);
    Serial.print(':');
	if (now.minute() < 10) {
		Serial.print("0");
	}
    Serial.print(now.minute(), DEC);
    Serial.print(':');
	if (now.second() < 10) {
		Serial.print("0");
	}
    Serial.print(now.second(), DEC);
	// You may want to print a newline character
	// after calling this function i.e. Serial.println();
}